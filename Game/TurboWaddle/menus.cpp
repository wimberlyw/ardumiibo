#include "menus.h"
#include "characters.h"

const uint8_t PROGMEM eggshell[] = {
32, 32,

  //FRAME 1
  0x00, 0x00, 0x00, 0x00, 0x00, 0x00, 0x00, 0x00, 0x00, 0x00, 0x00, 0x00, 0x00, 0x00, 0x00, 0x80, 0x80, 0x80, 0x80, 0x00, 0x00, 0x00, 0x00, 0x00, 0x00, 0x00, 0x00, 0x00, 0x00, 0x00, 0x00, 0x00, 
  0x00, 0x00, 0x00, 0x00, 0x00, 0x00, 0x00, 0x00, 0x80, 0xe0, 0x78, 0x1c, 0x06, 0x03, 0x03, 0x31, 0x31, 0x01, 0x01, 0x03, 0x03, 0x46, 0x1c, 0x78, 0xe0, 0x80, 0x00, 0x00, 0x00, 0x00, 0x00, 0x00, 
  0x00, 0x00, 0x00, 0x00, 0x00, 0x00, 0x00, 0xfe, 0xff, 0x01, 0x10, 0x00, 0x00, 0x02, 0x60, 0x60, 0x00, 0x00, 0x01, 0x00, 0x00, 0x18, 0x18, 0x00, 0x01, 0xff, 0xfe, 0x00, 0x00, 0x00, 0x00, 0x00, 
  0x00, 0x00, 0x00, 0x00, 0x00, 0x00, 0x00, 0x00, 0x03, 0x0f, 0x18, 0x30, 0x60, 0x61, 0xc0, 0xd8, 0xd8, 0xc0, 0xc1, 0xc0, 0x60, 0x62, 0x30, 0x1c, 0x0f, 0x03, 0x00, 0x00, 0x00, 0x00, 0x00, 0x00, 
  
  //FRAME 2
  0x00, 0x00, 0x00, 0x00, 0x00, 0x00, 0x00, 0x00, 0x00, 0x00, 0x00, 0x00, 0x00, 0x00, 0x00, 0x80, 0x80, 0x80, 0x80, 0x00, 0x00, 0x00, 0x00, 0x00, 0x00, 0x00, 0x00, 0x00, 0x00, 0x00, 0x00, 0x00, 
  0x00, 0x00, 0x00, 0x00, 0x00, 0x00, 0x00, 0x00, 0x80, 0xe0, 0x78, 0x1c, 0x06, 0x03, 0x03, 0x31, 0xb1, 0xc7, 0x79, 0x03, 0x03, 0x46, 0x1c, 0x78, 0xe0, 0x80, 0x00, 0x00, 0x00, 0x00, 0x00, 0x00, 
  0x00, 0x00, 0x00, 0x00, 0x00, 0x00, 0x00, 0xfe, 0xff, 0x01, 0x10, 0x00, 0x10, 0x0a, 0x68, 0x64, 0x03, 0x00, 0x01, 0x00, 0x00, 0x18, 0x18, 0x00, 0x01, 0xff, 0xfe, 0x00, 0x00, 0x00, 0x00, 0x00, 
  0x00, 0x00, 0x00, 0x00, 0x00, 0x00, 0x00, 0x00, 0x03, 0x0f, 0x18, 0x30, 0x60, 0x61, 0xc0, 0xd8, 0xd8, 0xc0, 0xc1, 0xc0, 0x60, 0x62, 0x30, 0x1c, 0x0f, 0x03, 0x00, 0x00, 0x00, 0x00, 0x00, 0x00, 
  
  //FRAME 3
 0x00, 0x00, 0x00, 0x00, 0x00, 0x00, 0x00, 0x00, 0x00, 0x00, 0x00, 0x00, 0x00, 0x00, 0x00, 0x80, 0x80, 0x80, 0x80, 0x00, 0x00, 0x00, 0x00, 0x00, 0x00, 0x00, 0x00, 0x00, 0x00, 0x00, 0x00, 0x00, 
  0x00, 0x00, 0x00, 0x00, 0x00, 0x00, 0x00, 0x00, 0x80, 0xe0, 0x78, 0x1c, 0x06, 0x03, 0x03, 0x31, 0xb1, 0xc7, 0x79, 0x03, 0x03, 0x46, 0x1c, 0x78, 0xe0, 0x80, 0x00, 0x00, 0x00, 0x00, 0x00, 0x00, 
  0x00, 0x00, 0x00, 0x00, 0x00, 0x00, 0x00, 0xfe, 0xff, 0x01, 0x10, 0x00, 0x10, 0x0a, 0x68, 0x64, 0x0f, 0x18, 0x31, 0xe0, 0x40, 0x98, 0x18, 0x00, 0x01, 0xff, 0xfe, 0x00, 0x00, 0x00, 0x00, 0x00, 
  0x00, 0x00, 0x00, 0x00, 0x00, 0x00, 0x00, 0x00, 0x03, 0x0f, 0x18, 0x30, 0x60, 0x61, 0xc0, 0xd8, 0xd8, 0xc0, 0xc1, 0xc0, 0x60, 0x62, 0x30, 0x1c, 0x0f, 0x03, 0x00, 0x00, 0x00, 0x00, 0x00, 0x00, 
  
  //FRAME 4
  0x00, 0x00, 0x00, 0x00, 0x00, 0x00, 0x00, 0x00, 0x00, 0x00, 0x00, 0x00, 0x00, 0x00, 0x00, 0x80, 0x80, 0x80, 0x80, 0x00, 0x00, 0x00, 0x00, 0x00, 0x00, 0x00, 0x00, 0x00, 0x00, 0x00, 0x00, 0x00, 
  0x00, 0x00, 0x00, 0x00, 0x00, 0x00, 0x00, 0x00, 0x80, 0xe0, 0x78, 0x1c, 0x06, 0x03, 0x03, 0x31, 0xb1, 0xc7, 0x79, 0x03, 0x03, 0x46, 0x1c, 0x78, 0xe0, 0x80, 0x00, 0x00, 0x00, 0x00, 0x00, 0x00, 
  0x00, 0x00, 0x00, 0x00, 0x00, 0x00, 0x00, 0xfe, 0xff, 0x01, 0x10, 0x00, 0x10, 0x0a, 0x68, 0x64, 0x0f, 0x18, 0x31, 0xe0, 0x40, 0x98, 0x18, 0x00, 0x01, 0xff, 0xfe, 0x00, 0x00, 0x00, 0x00, 0x00, 
  0x00, 0x00, 0x00, 0x00, 0x00, 0x00, 0x00, 0x00, 0x03, 0x0f, 0x18, 0x30, 0x70, 0x79, 0xcc, 0xde, 0xda, 0xc7, 0xcd, 0xd8, 0x70, 0x62, 0x30, 0x1c, 0x0f, 0x03, 0x00, 0x00, 0x00, 0x00, 0x00, 0x00, 
  
  //FRAME OPEN
  0x00, 0x00, 0x00, 0x00, 0x00, 0x00, 0x00, 0x00, 0x00, 0x00, 0x00, 0x00, 0x00, 0x00, 0x00, 0x00, 0x00, 0x00, 0x00, 0x00, 0x00, 0x00, 0x00, 0x00, 0x00, 0x00, 0x00, 0x00, 0x00, 0x00, 0x00, 0x00, 
  0x00, 0x00, 0x00, 0x00, 0x00, 0x00, 0x00, 0x00, 0x00, 0x00, 0x00, 0x00, 0x00, 0x00, 0x00, 0x00, 0x00, 0x00, 0x00, 0x00, 0x00, 0x00, 0x00, 0x00, 0x00, 0x00, 0x00, 0x00, 0x00, 0x00, 0x00, 0x00, 
  0xc0, 0xf0, 0xe0, 0x80, 0x00, 0x00, 0x00, 0x00, 0x00, 0x00, 0x00, 0x00, 0x00, 0x00, 0x00, 0x00, 0x00, 0x00, 0x00, 0x00, 0x00, 0x00, 0x00, 0x00, 0x00, 0x00, 0x00, 0x00, 0x00, 0xc0, 0x40, 0xe0, 
  0x07, 0x3c, 0x38, 0x61, 0xcb, 0xc6, 0xe6, 0x8c, 0xdc, 0xd8, 0xac, 0xc6, 0x86, 0xe6, 0xbc, 0xce, 0x8f, 0xbc, 0xfc, 0x9e, 0x86, 0xac, 0x88, 0xcc, 0x8c, 0xb6, 0xb6, 0xc6, 0xc3, 0x61, 0x38, 0x0f, 
};

Menus::Menus(){
  this->menuState = 0;
  this->animStep = 0;
  this->animStepAlt = 0;
  this->select = 0;
  this->scanWord = "";
  
}

void Menus::drawMenuTitle(int x, int y){
  Sprites::drawSelfMasked(x, y, intro, animStep);
}

int Menus::centerString(String input){
  return (6 * input.length()) / 2;
}

void Menus::ResetMenuStates(){
  this->menuState = 0;
  this->animStep = 0;
  this->animStepAlt = 0;
  this->select = 0;
  this->scanWord = "";
}

void Menus::Start(Arduboy2 ab,int x, int y){
  
  //ab.setCursor(x,y); 
  ab.setCursor(x,y);
  ab.print("< S T A R T >");

}

//creates character menu.  X and Y will be 0 unless animating
void Menus::CharacterSelect(Arduboy2 ab, String *characters, bool *unlocks, int x, int y){
  
  PlayerOne player;
  int charHeight = 16;
  
  ab.setTextSize(1);
  String toPrint = "Choose-A-Dude";
  ab.setCursor(x + 64 - (centerString(toPrint)*1),y+1);
  ab.print(toPrint);

  toPrint = "Scan ARDUIIBO!";
  ab.setCursor(x + 64 - (centerString(toPrint)*1),y+54);
  ab.print(toPrint);

   //
  if(ab.justPressed(RIGHT_BUTTON)){
    this->select = (this->select + 1) % 4;
  }else if(ab.justPressed(LEFT_BUTTON)){
    this->select = this->select == 0 ? 3 : this->select - 1;
  }else if(ab.justPressed(DOWN_BUTTON)){
    this->select = this->select == 4 ? 0 : 4;
  }else if(ab.justPressed(UP_BUTTON)){
    this->select = this->select < 4 ? 4 : 0;
  }


  //creates the square cursor that shows selections
  int selPosX = x+12+(28*this->select);
  if(this->select<4){    
    ab.drawRect(selPosX,y+14,20,20);
  }else{
    ab.setCursor(x + 64 - (centerString(toPrint)*1),y+54);
    ab.drawRect(ab.getCursorX()-3,ab.getCursorY()-3,toPrint.length()*6 + 4,13);
  }


   //animate chars
  if(ab.everyXFrames(4)){
    this->animStep = (this->animStep + 1) % 4;
  }
  
   //Display characters to select
  for(int i=0;i<4;i++){
    if(unlocks[i]){
      Sprites::drawSelfMasked(x+14+(28*i), y+charHeight, player.getSpriteSet(characters[i]), this->animStep);
    }else{
      ab.setCursor(x+17+(28*i),y+charHeight);
      ab.setTextSize(2);
      ab.print("?");
    } 
  }

  ab.setTextSize(1);
  if(select < 4){
    if(unlocks[this->select]){
      toPrint = characters[select];
    }else{
      toPrint = "Locked";
    }

    ab.setCursor(x + selPosX+10 - (centerString(toPrint)*1),40);
    ab.print(toPrint);
  }
  
 
}

bool Menus::ScanMenu(Arduboy2 ab, String *characters, bool *unlocks, int x, int y){
  
  if(this->menuState<4){
    if(this->menuState < 3){
      if(this->animStepAlt <= 0 ){
        this->animStepAlt = 15;
        this->menuState++;
      }

      if(ab.justPressed(A_BUTTON)){
        this->menuState = 4;
        this->select = 1;
        return;
      }
      
      if(ab.everyXFrames(2)){ //run through frames
        this->animStepAlt--;
      }
      
    }else{
      delay(3000);
      this->select = 1;
      this->menuState = 4;
      return;
      
    }
       
    if(this->menuState >= 0){
      ab.setCursor(x   + (this->menuState == 0 ? -pow(this->animStepAlt - 4,2) + 16 : 0) ,y + 15);
      ab.print("1: Attach scanner!");    
    }
    if(this->menuState >= 1){    
      ab.setCursor(x+9 + (this->menuState == 1 ? -pow(this->animStepAlt - 4,2) + 16 : 0),y + 30);
      ab.print("2: Turn scanner ON!");
    }
    if(this->menuState >= 2){
      ab.setCursor(x+18+ (this->menuState == 2 ? -pow(this->animStepAlt - 4,2) + 16 : 0),y + 45);
      ab.print("3: Place Arduiibo!");     
    }

    //---------------- END OF INSTRUCTIONS ---------------- 
  }else if(this->menuState == 4){
    if(this->select == 1){
      this->animStepAlt = 10;
      this->select = 0;
      this->animStep = 0;
    }
    
    float t = this->animStep/2.0f;
    ab.drawCircle(ab.width()/2 + sin(t)* 54, ab.height()/2 + cos(t)*20,10);
    ab.drawCircle(ab.width()/2 + sin(t)* -54, ab.height()/2 + cos(t)* -20,10);
   
    if(ab.everyXFrames(30)){
      this->animStepAlt--;
    }
     

    if(animStepAlt > 0){
      if(ab.justPressed(A_BUTTON)){
        this->menuState = 5; //CANCEL SCAN
        return;
      }

      //DEBUG
//      if(ab.justPressed(B_BUTTON)){
//        this->scanWord = "Dino";
//      }  

      
      String tempString = "TIMEOUT: " + String(animStepAlt,DEC);
      ab.setCursor(centerString(tempString)+4,29);
      ab.print(tempString);
          
      this->animStep++;

      // --------------------------------------------------------//
      // ---- ↓↓↓↓ ---- PUT SCANNER FUNCTION HERE ---- ↓↓↓↓ ----//
      if(Serial1.available())
      {
        scanWord = Serial1.readStringUntil('\r');
      }

      
      const uint8_t unlockedCharacter;
      if(this->scanWord != ""){             //if it is something besides a blank string
        scanWord.remove(0,3);
        //DEBUG
        ab.setCursor(0,0);
        ab.print(scanWord);
        
        for(int i=0;i<4;i++){               //search our array
          //if(scanWord == characters[i]){    // if it exists, do stuff.
          if(scanWord.indexOf(characters[i]) >= 0){
            unlocks[i] = true;
            
            this->animStep = 0;
            this->animStepAlt = 0;
            this->menuState = 6;
            return;          
          }
        }
      }
      
      // ---- ↑↑↑↑ ---- PUT SCANNER FUNCTION HERE ---- ↑↑↑↑ ----\\
      // --------------------------------------------------------\\
    
    }else{
      this->menuState = 5;// FAIL SCAN
    }
  //---------------- END OF SCANNER ---------------- 
  }
  else if(this->menuState == 5)
  {
    ab.setCursor(12,22);
    ab.print("ARDUIIBO NOT FOUND!");
    ab.setCursor(20,40);
    ab.print("PLEASE TRY AGAIN!");
    ab.display();
    this->menuState = 7;
    delay(2000);  
  }
  else if(this->menuState = 6)
  {
    
    UnlockScreen(ab,0,0);
    
  }
}

void Menus::UnlockScreen(Arduboy2 ab, int x, int y){
  if(this->select == 0)
  {
    openEgg(ab, ab.width()/2 - 16, ab.height()/2 - 13);
    if(animStepAlt > 30)
      select = 1;
  }else{
    Sprites::drawSelfMasked(ab.width()/2 - 16, ab.height()/2 - 13, eggshell, 4);

    PlayerOne iHateThis; //this is fucking awful.  I created an entire class just to use the spritesets.  How do i C++?
    Sprites::drawSelfMasked(ab.width()/2 - 8, ab.height()/2-2, iHateThis.getSpriteSet(this->scanWord), this->animStepAlt);
    if(ab.everyXFrames(3)){
      this->animStepAlt = (this->animStepAlt + 1) % 4;
    }
    String temp = "---- YOU UNLOCKED ----";
    ab.setTextSize(1);
    ab.setCursor(ab.width()/2 - centerString(temp),ab.height()-7);
    ab.print(temp);
  
    
  
    float t = this->animStep/8.0f;
    int eightX = ab.width()/2 + sin(t) * 15;
    int eightY = ab.height()/11  + (cos(t)*sin(t)) * 6;

    temp = this->scanWord + "!";
    ab.setCursor(eightX - centerString(temp)*2 ,eightY);
    ab.setTextSize(2);
    ab.print(temp);
    ab.setTextSize(1);
  
    this->animStep++;
  
    if(ab.justPressed(A_BUTTON) || ab.justPressed(B_BUTTON)){
      this->menuState = 7;
    }
  }
}

//plays the egg opening sequence.  Returns whether it is done or not
// needs its own draw calls in order to function properly.  It should be run in a while loop.
bool Menus::openEgg(Arduboy2 ab, int x, int y)
{

  //can use animStepAlt and Select
  if(this->animStepAlt == 0){
    ab.clear();
    
    Sprites::drawSelfMasked(x, y, eggshell, 0);
    ab.display();
    delay(750); 
    ab.clear();
    
    Sprites::drawSelfMasked(x, y, eggshell, 1);
    ab.display();
    delay(350); 
    ab.clear();
  
    Sprites::drawSelfMasked(x, y, eggshell, 2);
    ab.display();
    delay(350); 
    ab.clear();
    
    Sprites::drawSelfMasked(x, y, eggshell, 3);
    ab.display();
    delay(750);
    ab.clear();

    this->animStepAlt++;
  }
  //this->animStepAlt = 0;
  //while(oneTimer < 22){
  
  if(ab.everyXFrames(1)){
    int temp = (this->animStepAlt % 2);
    Sprites::drawSelfMasked(x + 2*temp, y, eggshell, 3); // open egg
    this->animStepAlt++;
  }
  
}
  
int Menus::swoosValue(int frame, bool negative){
  return -pow(frame - 4,2) + 16;
}


  
